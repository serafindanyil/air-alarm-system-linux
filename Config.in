## Config.in
```kconfig
source "$BR2_EXTERNAL_AIR_ALARM_SYSTEM_PATH/package/cpr/Config.in"
source "$BR2_EXTERNAL_AIR_ALARM_SYSTEM_PATH/package/nlohmann-json/Config.in"
source "$BR2_EXTERNAL_AIR_ALARM_SYSTEM_PATH/package/internet-monitor-service/Config.in"
source "$BR2_EXTERNAL_AIR_ALARM_SYSTEM_PATH/package/air-alarm-service/Config.in"
```

## package/air-alarm-service/Config.in
```kconfig
config BR2_PACKAGE_AIR_ALARM_SERVICE
    bool "air-alarm-service"
    depends on BR2_INSTALL_LIBSTDCPP
    select BR2_PACKAGE_NLOHMANN_JSON
    select BR2_PACKAGE_CPR
    select BR2_PACKAGE_LIBGPIOD2
    select BR2_PACKAGE_SDBUS_CPP
    help
      Air Alarm Service.
```

## package/cpr/Config.in
```kconfig
config BR2_PACKAGE_CPR
    bool "cpr"
    depends on BR2_INSTALL_LIBSTDCPP
    select BR2_PACKAGE_LIBCURL
    help
      C++ Requests library.
```

## package/internet-monitor-service/Config.in
```kconfig
config BR2_PACKAGE_INTERNET_MONITOR_SERVICE
    bool "internet-monitor-service"
    depends on BR2_INSTALL_LIBSTDCPP
    select BR2_PACKAGE_SDBUS_CPP
    help
      Internet Monitor Service daemon with D-Bus.
```
